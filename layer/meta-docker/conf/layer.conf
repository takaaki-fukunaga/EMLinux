## layer/meta-docker/conf/layer.conf
```bitbake
#
# layer profile
#

BBPATH .= ":${LAYERDIR}"

BBFILES += "${LAYERDIR}/recipes-*/*/*.bb \
        ${LAYERDIR}/recipes-*/*/*.bbappend"

BBFILE_COLLECTIONS += "docker"
BBFILE_PATTERN_docker = "^${LAYERDIR}/"
BBFILE_PRIORITY_docker = "30"

LAYERSERIES_COMPAT_docker = "next"

LAYERDIR_docker = "${LAYERDIR}"
```

## layer/meta-k3s/conf/layer.conf
```bitbake
#
# layer profile
#

BBPATH .= ":${LAYERDIR}"

BBFILES += "${LAYERDIR}/recipes-*/*/*.bb \
        ${LAYERDIR}/recipes-*/*/*.bbappend"

BBFILE_COLLECTIONS += "k3s"
BBFILE_PATTERN_k3s = "^${LAYERDIR}/"
BBFILE_PRIORITY_k3s = "30"

LAYERSERIES_COMPAT_k3s = "next"

LAYERDIR_k3s = "${LAYERDIR}"     
```

## layer/meta-k3s/conf/machine/qemu-arm64-k3s.conf
```bitbake
DISTRO_ARCH = "arm64"

IMAGE_FSTYPES ?= "ext4"

KERNEL_DEFCONFIG = "qemu-arm64_k3s_defconfig"
```

## layer/meta-podman/conf/layer.conf
```bitbake
#
# layer profile
#

BBPATH .= ":${LAYERDIR}"

BBFILES += "${LAYERDIR}/recipes-*/*/*.bb \
        ${LAYERDIR}/recipes-*/*/*.bbappend"

BBFILE_COLLECTIONS += "podman"
BBFILE_PATTERN_podman = "^${LAYERDIR}/"
BBFILE_PRIORITY_podman = "30"

LAYERSERIES_COMPAT_podman = "next"

LAYERDIR_podman = "${LAYERDIR}"
```
